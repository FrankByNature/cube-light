#include <Adafruit_NeoPixel.h>
#include <Wire.h>

//Output pins
int P1 = 8; int P2 = 7; int P3 = 6; int P4 = 5; int P5 = 4;
int NUM_LED = 25;
int I2C_adrs = 32;

// 16-bit LED values: upper 8 bits = integer (0-64), lower 8 bits = fraction
uint16_t LEDs[2][5][25][3] = {0};
volatile int writeBuffer = 0;
volatile int readBuffer = 1;
volatile bool newFrame = false;

// Dither accumulators - one per LED per channel
uint8_t accum[5][25][3] = {0};

// Gamma lookup table: maps linear 0-255 input to 16-bit gamma-corrected value
// Upper byte = integer output (0-64, i.e. 25% brightness cap)
// Lower byte = fractional remainder for dithering
const uint16_t gamma16[256] = {
0x0000, 0x0000, 0x0000, 0x0000, 0x0001, 0x0002, 0x0003, 0x0004, 0x0006, 0x0008, 0x000A, 0x000D, 0x000F, 0x0013, 0x0016, 0x001A, 
0x001E, 0x0022, 0x0027, 0x002B, 0x0031, 0x0036, 0x003C, 0x0042, 0x0049, 0x0050, 0x0057, 0x005F, 0x0067, 0x006F, 0x0078, 0x0081, 
0x008A, 0x0094, 0x009E, 0x00A8, 0x00B3, 0x00BE, 0x00CA, 0x00D5, 0x00E2, 0x00EE, 0x00FB, 0x0109, 0x0116, 0x0125, 0x0133, 0x0142, 
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0x2D81, 0x2DEC, 0x2E58, 0x2EC4, 0x2F31, 0x2F9E, 0x300C, 0x307A, 0x30E9, 0x3158, 0x31C8, 0x3238, 0x32A9, 0x331B, 0x338D, 0x3400
};

Adafruit_NeoPixel strip1(NUM_LED, P1, NEO_GRB + NEO_KHZ800);
Adafruit_NeoPixel strip2(NUM_LED, P2, NEO_GRB + NEO_KHZ800);
Adafruit_NeoPixel strip3(NUM_LED, P3, NEO_GRB + NEO_KHZ800);
Adafruit_NeoPixel strip4(NUM_LED, P4, NEO_GRB + NEO_KHZ800);
Adafruit_NeoPixel strip5(NUM_LED, P5, NEO_GRB + NEO_KHZ800);

// Helper to get a dithered 8-bit output value for one channel of one LED
uint8_t dither(int strip, int led, int ch) {
  uint16_t val     = LEDs[readBuffer][strip][led][ch];
  uint8_t integer  = val >> 8;
  uint8_t fraction = val & 0xFF;
  accum[strip][led][ch] += fraction;
  if (accum[strip][led][ch] < fraction) integer++;
  return integer;
}

void setup() {
  Wire.setSDA(0); Wire.setSCL(1);
  Wire.begin(I2C_adrs);
  Wire.onReceive(rcv);
}

void loop() {
  tight_loop_contents();
}

void setup1() {
  strip1.begin(); strip2.begin(); strip3.begin(); strip4.begin(); strip5.begin();
  strip1.show(); strip2.show(); strip3.show(); strip4.show(); strip5.show();
}

void loop1() {
  if (newFrame) {
    newFrame = false;
    writeBuffer = 1 - writeBuffer;
    readBuffer = 1 - writeBuffer;
  }

  for (int x = 0; x < 25; x++) {
    strip1.setPixelColor(x, dither(0,x,0), dither(0,x,1), dither(0,x,2));
    strip2.setPixelColor(x, dither(1,x,0), dither(1,x,1), dither(1,x,2));
    strip3.setPixelColor(x, dither(2,x,0), dither(2,x,1), dither(2,x,2));
    strip4.setPixelColor(x, dither(3,x,0), dither(3,x,1), dither(3,x,2));
    strip5.setPixelColor(x, dither(4,x,0), dither(4,x,1), dither(4,x,2));
  }
  strip1.show(); strip2.show(); strip3.show(); strip4.show(); strip5.show();
}

void rcv(int byteCount) {
  int counter = 0;
  uint8_t data[16] = {0};
  while (Wire.available() && counter < 16) {
    data[counter++] = Wire.read();
  }

  int target_loc   = data[0];
  int target_strip = target_loc / 5;
  int target_row   = target_loc % 5;

  if (target_strip > 4 || target_row > 4) return;

  for (int x = 0; x < 5; x++) {
    for (int y = 0; y < 3; y++) {
      uint8_t incoming = data[1 + x*3 + y];
      LEDs[writeBuffer][target_strip][target_row*5 + x][y] = gamma16[incoming];
    }
  }
  if (target_loc == 24) {
    newFrame = true;
  }
}
