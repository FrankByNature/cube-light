#include <Adafruit_NeoPixel.h>
#include <Wire.h>

//Output pins
int P1 = 4; int P2 = 5; int P3 = 6; int P4 = 7; int P5 = 8;
int NUM_LED = 5;
int v1; int v2; int v3;
int LEDs[2][5][5][3] = {0};
volatile int writeBuffer = 0;
volatile int readBuffer = 1;
volatile bool newFrame = false;

// Dither accumulators - one per LED per channel
uint8_t accum[5][5][3] = {0};

// Gamma lookup table: maps linear 0-255 input to 16-bit gamma-corrected value
// Upper byte = integer output (0-64, i.e. 25% brightness cap)
// Lower byte = fractional remainder for dithering
const uint16_t gamma16[256] = {
0x0000, 0x0000, 0x0000, 0x0001, 0x0002, 0x0003, 0x0005, 0x0007, 0x0009, 0x000C, 0x0010, 0x0013, 0x0017, 0x001C, 0x0021, 0x0027,
0x002D, 0x0033, 0x003A, 0x0041, 0x0049, 0x0052, 0x005B, 0x0064, 0x006E, 0x0078, 0x0083, 0x008E, 0x009A, 0x00A7, 0x00B4, 0x00C1,
0x00CF, 0x00DE, 0x00ED, 0x00FC, 0x010D, 0x011D, 0x012F, 0x0140, 0x0153, 0x0166, 0x0179, 0x018D, 0x01A2, 0x01B7, 0x01CD, 0x01E3,
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0x4442, 0x44E3, 0x4584, 0x4626, 0x46C9, 0x476D, 0x4812, 0x48B7, 0x495D, 0x4A04, 0x4AAC, 0x4B55, 0x4BFE, 0x4CA9, 0x4D54, 0x4E00
};

Adafruit_NeoPixel strip1(NUM_LED, P1, NEO_GRB + NEO_KHZ800);
Adafruit_NeoPixel strip2(NUM_LED, P2, NEO_GRB + NEO_KHZ800);
Adafruit_NeoPixel strip3(NUM_LED, P3, NEO_GRB + NEO_KHZ800);
Adafruit_NeoPixel strip4(NUM_LED, P4, NEO_GRB + NEO_KHZ800);
Adafruit_NeoPixel strip5(NUM_LED, P5, NEO_GRB + NEO_KHZ800);

// Helper to get a dithered 8-bit output value for one channel of one LED
uint8_t dither(int strip, int led, int ch) {
  uint16_t val     = LEDs[readBuffer][strip][led][ch];
  uint8_t integer  = val >> 8;
  uint8_t fraction = val & 0xFF;
  accum[strip][led][ch] += fraction;
  if (accum[strip][led][ch] < fraction) integer++;
  return integer;
}

void setup() {
  // Address Selection: 33(1,0,0), 34(0,1,0), 35(1,1,0), 36(0,0,1), 37(1,0,1)
  pinMode(27, INPUT); pinMode(28, INPUT); pinMode(29, INPUT);
  v1 = digitalRead(27); v2 = digitalRead(28); v3 = digitalRead(29);
  int I2C_adrs = 32 + v1 + 2*v2 + 4*v3;
  Wire.setSDA(0); Wire.setSCL(1);
  Wire.begin(I2C_adrs);
  Wire.onReceive(rcv);
}

void loop() {
  tight_loop_contents();
}

void setup1() {
  strip1.begin(); strip2.begin(); strip3.begin(); strip4.begin(); strip5.begin();
  strip1.show(); strip2.show(); strip3.show(); strip4.show(); strip5.show();
}

void loop1() {
  if (newFrame) {
    newFrame = false;
    writeBuffer = 1 - writeBuffer;
    readBuffer = 1 - writeBuffer;
  }
    
  for (int x = 0; x < 5; x++) {
    strip1.setPixelColor(x, dither(0,x,0), dither(0,x,1), dither(0,x,2));
    strip2.setPixelColor(x, dither(1,x,0), dither(1,x,1), dither(1,x,2));
    strip3.setPixelColor(x, dither(2,x,0), dither(2,x,1), dither(2,x,2));
    strip4.setPixelColor(x, dither(3,x,0), dither(3,x,1), dither(3,x,2));
    strip5.setPixelColor(x, dither(4,x,0), dither(4,x,1), dither(4,x,2));
  }
  strip1.show(); strip2.show(); strip3.show(); strip4.show(); strip5.show();
}

void rcv(int byteCount) {  
  int counter = 0;
  int data[16] = {0};
  while(Wire.available() && counter < 16) {
      data[counter++] = Wire.read();
  }
  
  int target_strip = data[0];

  for (int x = 0; x < 5; x++) {
    for (int y = 0; y < 3; y++) {
      uint8_t incoming = data[1 + x*3 + y];
      LEDs[writeBuffer][target_strip][x][y] = gamma16[incoming];
    }
  }

  if (target_strip == 4) {
    newFrame = true;
  }
}
